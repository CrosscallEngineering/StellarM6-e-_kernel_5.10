## drivers/input/fingerprint/Kconfig
```kconfig
config HBSP_FINGERPRINT
	tristate "fingerprint drvier support"
	help
	  Say Y here to enable fingerprint driver support!

config FINGERPRINT_SUNWAVE
	tristate "SUNWAVE SW9651 fingerprint drvier support"
	depends on HBSP_FINGERPRINT
	help
	  Say Y here to enable sunwave sw9651 driver support!

config FINGERPRINT_CHIPONE
	tristate "CHIPONE fingerprint driver support"
	depends on HBSP_FINGERPRINT
	help
	  Say Y here to enable CHIPONE Fingerpirnt driver support!

config FINGERPRINT_FOCALTECH
	tristate "CHIPONE fingerprint driver support"
	depends on HBSP_FINGERPRINT
	help
	  Say Y here to enable CHIPONE Fingerpirnt driver support!

config FINGERPRINT_FPC_FPC1542
	tristate "FPC FPC1542 fingerprint drvier support"
	depends on HBSP_FINGERPRINT
	help
	  Say Y here to enable FPC FPC1542 driver support!

config FP_LOGIC_PWR_CTRL_COMMON
	tristate "common finger LOGIC CURRRENT-LIMITING FUNCTION SUPPORT"
	depends on HBSP_FINGERPRINT
	help
	  Say Y here to enable common current-limiting function support!

config FP_REPORT_WAKEUP_KEY
	bool "fingerprint report wakeup system key"
	default n
	depends on HBSP_DEBUG_CTRL && KEYBOARD_GPIO
	help
	  Say Y here to enable fingerprint report wakeup key event
```

## drivers/nfc/st54/Kconfig
```kconfig
# SPDX-License-Identifier: GPL-2.0-only
config NFC_ST54
	tristate "ST54 I2C NFC Transceiver driver"
	depends on I2C
	help
	This enables the ST NFC driver for ST54 transceiver.
	This makes use of I2C framework to communicate with transceiver.

	Say Y here to compile support for ST NFC transceiver ST54
	linux driver into the kernel or say M to compile it as module.
```

## drivers/soc/hsoc/Kconfig
```kconfig
source "drivers/soc/hsoc/base/Kconfig"

source "drivers/soc/hsoc/pm/Kconfig"

source "drivers/soc/hsoc/usb/Kconfig"

source "drivers/soc/hsoc/pmic/Kconfig"

source "drivers/soc/hsoc/debug/Kconfig"

source "drivers/soc/hsoc/efuse/Kconfig"

source "drivers/soc/hsoc/sensor/Kconfig"

source "drivers/soc/hsoc/misc/Kconfig"

source "drivers/soc/hsoc/abnormal_stats/Kconfig"
```

## drivers/soc/hsoc/abnormal_stats/Kconfig
```kconfig
config SUBSYS_ERR_REPORT
	tristate "report subsystem failed event by uevent"
	depends on PRODUCT_BASEINFO
	default n
	help
	  Enable it when collect the subsystem state report
	  if unsure, say N
```

## drivers/soc/hsoc/base/Kconfig
```kconfig
config MACH_HSOC_SMARTPHONE
	tristate "HSOC DEVICE"
	default n
	help
	  Support for the HSOC samrtphone board.

config HVENDOR_NAME
	depends on MACH_HSOC_SMARTPHONE
	string "H-vendor info"
	default ""
	help
	  The vendor name of product.

config HPRODUCT_NAME
	depends on MACH_HSOC_SMARTPHONE
	string "H-product info"
	default ""
	help
	  The product name.

config PRODUCT_BASEINFO
	depends on MACH_HSOC_SMARTPHONE
	tristate "device base info of H-product"
	help
	  Provide a methed to register the peripheral device
	  infomation of product.

config PRODUCT_DEVINFO
	depends on PRODUCT_BASEINFO
	bool "device info register of product"
	default y
	help
	  Provide a methed to register the peripheral device
	  infomation of product.

config BSP_DEBUG_CTRL
	bool "debug code ctrl"
	depends on PRODUCT_BASEINFO
	default y
	help
	  Say Y when you need debug your device.

config BOOT_FLOW
	bool "boot flow"
	depends on MACH_HSOC_SMARTPHONE
	default n
	help
	  Provide the special boot flow.
```

## drivers/soc/hsoc/debug/Kconfig
```kconfig
config PRODUCT_DEBUGINFO
	depends on MACH_HSOC_SMARTPHONE
	tristate "device debug info of product"
	help
	  Provide a methed to register the peripheral device
	  infomation of product.

config PANIC_HANDLE
	bool "panic handle flow"
	depends on PRODUCT_DEBUGINFO
	default n
	help
	  Provide a methed for panic handle.

config RELEASE_VERSION
	bool "release version flag"
	depends on PRODUCT_DEBUGINFO
	default n
	help
	  The information of release version.

config DEBUG_BOOT_TIME
	bool "debug boot performance"
	depends on PRODUCT_DEBUGINFO
	depends on MSM_BOOT_STATS
	default n
	help
	  The way to debug the boot time.

config BOOTLOADER_LOG
	tristate "show bootloader log"
	depends on BSP_DEBUG_CTRL
	default n
	help
	  If enable, you can get boot log via
	  "cat /proc/debug_control/bootloader_log"
```

## drivers/soc/hsoc/efuse/Kconfig
```kconfig
config QCOM_CHIP_EFUSE
	tristate "read the fuse status for qcom chip"
	depends on MACH_HSOC_SMARTPHONE
	help
	  add the fuse status node to read qcom chip efuse status
```

## drivers/soc/hsoc/misc/Kconfig
```kconfig
config SIM_SWITCH_CTRL
	tristate "enable sim switch control"
	default n
	help
	  Say 'y' here to enable sim switch control

config SIM_PLUG_REPORT
	bool "sim plug pin irq status report"
	depends on SIM_SWITCH_CTRL
	default n
	help
	  Say 'y' here to enable plug pin irq status report
```

## drivers/soc/hsoc/pm/Kconfig
```kconfig
config HPM_DEBUG
	tristate "pm debug"
	depends on MACH_HSOC_SMARTPHONE
	default n
	help
	  print clk, gpio, vreg status when the device enter suspend mode.

config HSUSPEND_SYS_SYNC
	bool "add the suspend sys sync to the workqueue"
	depends on HPM_DEBUG
	depends on SUSPEND_SKIP_SYNC
	default n
	help
	  Enable it when the suspend/resume has some sync issue.
	  if unsure, say N

config HSUSPEND_DEBUG
	tristate "Suspend debug and optimize"
	depends on HPM_DEBUG
	default n
	help
	  print suspend debug log and suspend file sync.

config HQPNP_REG_DEBUG
	tristate "raw register debug support for QPNP PMIC"
	depends on SPMI
	default n
	help
	  This option enables SMPS/LDO/ADC debug for Qualcomm's QPNP PMIC
```

## drivers/soc/hsoc/pmic/Kconfig
```kconfig
config CHARGE_FG_FUNCTION
	bool "Add the charge/fg driver"
	depends on MACH_HSOC_SMARTPHONE
	default n
	help
	  Add the charge function. Such as
	  smb-charger,fg and so on.

config CHARGE_CP_FUNCTION
	bool "Add the charge/cp driver"
	depends on MACH_HSOC_SMARTPHONE
	default n
	help
	  Add the charge function. Such as
	  sc8551-charger,cp and so on.

config WEAK_CHARGER
	bool "Add the WEAK charger or line support"
	depends on CHARGE_FG_FUNCTION
	default n
	help
	  Add weak charger or line support.

config TYPEC_OTG_CONTROL_FUNCTION
	bool "type c OTG control"
	depends on MACH_HSOC_SMARTPHONE
	default n
	help
	 y to use type c OTG control.
	 n not using type c OTG control.

config BATTERY_THERM_NTC_10K
	bool "using battery thermal 10k ntc"
	depends on MACH_HSOC_SMARTPHONE
	default n
	help
	 y to use 10k ntc.
	 n to use default 100k ntc.
```

## drivers/soc/hsoc/sensor/Kconfig
```kconfig
#
# sensors device configuration
#
config SENSORS
	tristate "Sensors Class Support"
	help
	  This option enables the sensor sysfs class in /sys/class/sensors.
	  You'll need this to do anything useful with sensorss. If unsure, say N.

menu "H-sensors device support"
	depends on SENSORS

config HS_SNS_ACC
	bool "Provide Accelerometer Device Support"
	default n
	depends on SENSORS
	help
	  Say Y here, a list of availible accelerometer chips shall be shown.
	  Then you can select one or more chip for one project.

choice
	prompt "Choice Acc sensor plant side"
	default HS_SNS_ADSP_ACC
	depends on HS_SNS_ACC

config HS_SNS_AP_ACC
	bool "The Acc sensor plant in the AP side"

config HS_SNS_ADSP_ACC
	bool "The Acc sensor plant in the ADSP side"

endchoice

config ACC_SENSOR_VENDOR
	string "ACC SENSOR VENDOR"
	depends on HS_SNS_ADSP_ACC
	default ""
	help
		Add vendor info for ACC sensor.

config ACC_SENSOR_TYPE
	string "ACC SENSOR TYPE"
	depends on HS_SNS_ADSP_ACC
	default ""
	help
		Add type info for ACC sensor.

config HS_SNS_MAG
	bool "Provide Magnetic Device Support"
	default n
	depends on HS_SNS_ACC
	help
		Say Y here, a list of availible Magnetic chips shall be shown.
		Then you can select one or more chip for one project.
	
choice
	prompt "Choice Mag sensor plant side"
	default HS_SNS_ADSP_MAG
	depends on HS_SNS_MAG

config HS_SNS_AP_MAG
	bool "The Mag sensor plant in the AP side"

config HS_SNS_ADSP_MAG
	bool "The Mag sensor plant in the ADSP side"

endchoice

config MAG_SENSOR_VENDOR
	string "MAG SENSOR VENDOR"
	depends on HS_SNS_ADSP_MAG
	default ""
	help
		Add vendor info for MAG sensor.
		This option only used for ADSP.

config MAG_SENSOR_TYPE
	string "MAG SENSOR TYPE"
	depends on HS_SNS_ADSP_MAG
	default ""
	help
		Add type info for MAG sensor.
		This option only used for ADSP.

config HS_SNS_GYRO
	bool "Provide Gyroscope Device Support"
	default n
	depends on HS_SNS_ACC
	help
	  Say Y here, a list of availible Gyroscope chips shall be shown.
	  Then you can select one or more chip for one project.
	
choice
	prompt "Choice Gyro sensor plant side"
	default HS_SNS_ADSP_GYRO
	depends on HS_SNS_GYRO

config HS_SNS_AP_GYRO
	bool "The Mag sensor plant in the AP side"

config HS_SNS_ADSP_GYRO
	bool "The Mag sensor plant in the ADSP side"

endchoice

config GYRO_SENSOR_VENDOR
	string "GYRO SENSOR VENDOR"
	depends on HS_SNS_ADSP_GYRO
	default ""
	help
		Add vendor info for GYRO sensor.
		This option only used for ADSP.

config GYRO_SENSOR_TYPE
	string "GYRO SENSOR TYPE"
	depends on HS_SNS_ADSP_GYRO
	default ""
	help
		Add type info for GYRO sensor.
		This option only used for ADSP.

config HS_SNS_ALS_PS
	bool "Provide Optical Sensor Device Support"
	default n
	depends on SENSORS
	help
		Say Y here, a list of availible Optical Sensor chips shall be shown.

config HS_SNS_ADSP_ALSPS
	bool "Provide Optical Sensor Device Support"
	default n
	depends on SENSORS
	help
		Say Y here, a list of availible Optical Sensor chips shall be shown.

config ALSP_SENSOR_VENDOR
	string "ALSPS SENSOR VENDOR"
	depends on HS_SNS_ADSP_ALSPS
	default ""
	help
		Add vendor info for ALSPS sensor.
		This option only used for ADSP.

config ALSP_SENSOR_TYPE
	string "ALSP SENSOR TYPE"
	depends on HS_SNS_ADSP_ALSPS
	default ""
	help
		Add type info for ALSPS sensor.
		This option only used for ADSP.

config HS_SNS_SAR
	bool "Provide Sar Device Support"
	default n
	depends on SENSORS
	help
		Say Y here, a list of availible Sar chips shall be shown.
		Then you can select one or more chip for one project.
	
choice
	prompt "Choice Sar sensor plant side"
	default HS_SNS_ADSP_SAR
	depends on HS_SNS_SAR

config HS_SNS_AP_SAR
	bool "The Sar sensor plant in the AP side"

config HS_SNS_ADSP_SAR
	bool "The Sar sensor plant in the ADSP side"

endchoice

config SAR_SENSOR_VENDOR
	string "SAR SENSOR VENDOR"
	depends on HS_SNS_ADSP_SAR
	default ""
	help
		Add vendor info for SAR sensor.
		This option only used for ADSP.

config SAR_SENSOR_TYPE
	string "SAR SENSOR TYPE"
	depends on HS_SNS_ADSP_SAR
	default ""
	help
		Add type info for SAR sensor.
		This option only used for ADSP.

endmenu
```

## drivers/soc/hsoc/usb/Kconfig
```kconfig
config HSOC_USB_FEATURE
	bool "Enable usb feature"
	depends on MACH_HSOC_SMARTPHONE
	help
	  Enable the config if enable usb feature .
	  If unsure, say N
```
